## MTK/Kconfig
```kconfig
config KLAPSE_LIVEDISPLAY
  bool CONFIG_KLAPSE_LIVEDISPLAY
  default n
  help
    A simple rgb dynamic lapsing module similar to livedisplay
```

## drivers/gpu/drm/msm/Kconfig
```kconfig
config KLAPSE
    bool CONFIG_KLAPSE
    depends on DRM_MSM
    default n
    help
        A simple rgb dynamic lapsing module similar to LineageOS' livedisplay
```

## drivers/video/msm/mdss/Kconfig
```kconfig
config FB_MSM_MDSS_KCAL_CTRL
	depends on FB_MSM_MDSS
	bool "MDSS color control"
	---help---
	  Enable sysfs for post-processing control of mdss-mdp5 display
	  controllers in MDSS.
```
